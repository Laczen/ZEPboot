## CMakeLists.txt
```
cmake_minimum_required(VERSION 3.13.1)
include($ENV{ZEPHYR_BASE}/cmake/app/boilerplate.cmake NO_POLICY_SCOPE)
project(zepboot)

FILE(GLOB app_sources ../zepboot/src/*.c src/*.c)

target_sources(app PRIVATE ${app_sources})
```

## prj.conf
```kconfig
CONFIG_FLASH=y
CONFIG_FLASH_PAGE_LAYOUT=n

CONFIG_TINYCRYPT=y
CONFIG_TINYCRYPT_SHA256=y
CONFIG_TINYCRYPT_ECC_DH=y
CONFIG_TINYCRYPT_ECC_DSA=y
CONFIG_TINYCRYPT_AES=y
CONFIG_TINYCRYPT_AES_CTR=y

CONFIG_I2C=n
CONFIG_WATCHDOG=n
CONFIG_GPIO=n
CONFIG_PINMUX=n
CONFIG_SPI=n
CONFIG_SYS_POWER_MANAGEMENT=n
CONFIG_BT=n

CONFIG_ARM=y
CONFIG_ARM_MPU=n

CONFIG_BOOT_BANNER=n
CONFIG_BOOT_DELAY=0
#CONFIG_DEBUG=n

# Console
CONFIG_LOG=y
CONFIG_LOG_IMMEDIATE=y
CONFIG_CONSOLE=y
CONFIG_EARLY_CONSOLE=y
CONFIG_UART_CONSOLE=y
CONFIG_STDOUT_CONSOLE=y
CONFIG_PRINTK=y
CONFIG_SERIAL=y

CONFIG_MULTITHREADING=n

CONFIG_NUM_PREEMPT_PRIORITIES=0
#CONFIG_SYS_CLOCK_TICKS_PER_SEC=0
```

## src/main.c
```c
/*
 * Copyright (c) 2019 LaczenJMS.
 *
 * SPDX-License-Identifier: Apache-2.0
 */

#include <zephyr.h>
#include <misc/reboot.h>
#include <device.h>
#include <string.h>
#include <soc.h>
#include "../../zepboot/include/zb_flash.h"
#include "../../zepboot/include/zb_move.h"

#include <logging/log.h>
LOG_MODULE_REGISTER(main);

struct arm_vector_table {
    u32_t msp;
    u32_t reset;
};

static void do_boot(off_t load_address)
{
    struct arm_vector_table *vt;

    vt = (struct arm_vector_table *)(load_address);

    irq_lock();

    __set_MSP(vt->msp);
    ((void (*)(void))vt->reset)();
}

void main(void)
{
	int rc = 0, cnt;
	struct zb_slt_area area;
	struct zb_prm prm;
	struct zb_cmd cmd;
	zb_img_info info;
	u32_t crc32;

	cnt = zb_slt_area_cnt();

	/* Start or continue swap */
	while ((cnt--) > 0) {
		rc = zb_slt_area_get(&area, cnt);
		if (!rc) {
			rc = zb_img_swap(&area);
		}
	}

	/* Boot is done for images slot_map[0], area is already set OK */
	if (!rc) {
		rc = zb_prm_read(&area, &prm);
	}

	if (!rc) {
		zb_cmd_read_slt1end(&area, &cmd);
		if (cmd.cmd1 == CMD1_MASK_BT0_REQUEST) {
			prm.pri_ld_address = prm.sec_ld_address;
		}
	}

	/* Verify crc32 prior to boot */
	if ((!rc) && zb_in_slt_area(&area, 1, prm.pri_ld_address)) {
		zb_img_get_info_nsc(&info, &area, 1, 0, false);
		zb_img_calc_crc32(&info, &crc32);
		if (prm.slt1_crc32 != crc32) {
			prm.pri_ld_address = prm.sec_ld_address;
		}
	}

	if ((!rc) && (zb_in_slt_area(&area, 0, prm.pri_ld_address) ||
		      zb_in_ram(prm.pri_ld_address))) {
		zb_img_get_info_nsc(&info, &area, 0, 0, false);
		zb_img_calc_crc32(&info, &crc32);
		if (prm.slt0_crc32 != crc32) {
			rc = -EFAULT;
		}
		if ((!rc) && zb_in_ram(prm.pri_ld_address)) {
			rc = zb_img_ram_move(&info);
		}
	}

	if (!rc) {
		LOG_INF("Ready to boot [addr %x]", prm.pri_ld_address);
		/* boot */
		do_boot(prm.pri_ld_address);
	} else {
		LOG_ERR("Nothing valid to boot");
	}

}
```

## src/keys.c
```c
/* Autogenerated by imgtool.py, do not edit. */
const unsigned char ec256_boot_pri_key[] = {
	0xf6, 0x96, 0xe9, 0x4f, 0xa5, 0x5d, 0xd1, 0xda,
	0x2b, 0x77, 0x44, 0x8d, 0x5b, 0x0a, 0x25, 0x3d,
	0x6b, 0x12, 0x59, 0xe9, 0x7f, 0x9f, 0x75, 0x18,
	0x9c, 0xa3, 0xbd, 0x2c, 0x3a, 0x17, 0x5d, 0x83,
};
const unsigned int ec256_boot_pri_key_len = 32;

const unsigned char ec256_root_pub_key[] = {
	0x2e, 0x8d, 0xef, 0xb8, 0x12, 0xf7, 0x2d, 0x71,
	0x2f, 0xdf, 0xc5, 0xa5, 0x2c, 0x08, 0x5d, 0xc8,
	0xd5, 0x7d, 0x8f, 0x5b, 0xa9, 0xa4, 0x93, 0xf3,
	0xe7, 0x9e, 0x37, 0x98, 0xef, 0xf8, 0xbd, 0x41,
	0x37, 0x94, 0x32, 0x79, 0xea, 0x3b, 0xdc, 0xd4,
	0x9a, 0xc9, 0xb0, 0x98, 0x06, 0x33, 0xee, 0x83,
	0xfd, 0x24, 0x81, 0xfe, 0x09, 0xfa, 0xd3, 0xde,
	0xda, 0xc0, 0x13, 0xd0, 0xad, 0x2b, 0x15, 0x1d,
};
const unsigned int ec256_root_pub_key_len = 64;
```

## src/slotmap.c
```c
/*
 * Copyright (c) 2018 Laczen
 *
 * Slot map definition: all slot areas are described in this file. A slot area
 * is a region in flash that contains 3 seperate regions: a slot 0 region from
 * where a image is normally executed, a slot 1 region that is used to store
 * a image upgrade and a status region that is used to track the move status.
 * When a image upgrade is placed in slot 1, the bootloader will detect if it
 * is new, validate the upgrade and if ok start the move to either slot 0 or
 * remain in slot 1.
 * When there are no image upgrades in any of the slot areas the bootloader
 * will boot the image in slot_map[0], slot 0 or slot 1. Images in slot 1
 * are only booted if the load_address is equal to the location in slot 1.
 *
 * SPDX-License-Identifier: Apache-2.0
 */
#include "../../zepboot/include/zb_flash.h"

const struct slt_area slot_map[] = {
	{.slt0_offset = DT_FLASH_AREA_IMAGE_0_OFFSET,
	 .slt1_offset = DT_FLASH_AREA_IMAGE_1_OFFSET,
	 .swpstat_offset = DT_FLASH_AREA_IMAGE_SCRATCH_OFFSET,
	 .slt0_size = DT_FLASH_AREA_IMAGE_0_SIZE,
	 .slt1_size = DT_FLASH_AREA_IMAGE_1_SIZE,
	 .swpstat_size = DT_FLASH_AREA_IMAGE_SCRATCH_SIZE,
	 .slt0_devname = DT_FLASH_AREA_0_DEV,
	 .slt1_devname = DT_FLASH_AREA_0_DEV,
	 .swpstat_devname = DT_FLASH_AREA_0_DEV,
	},
};

const unsigned int slot_map_cnt = sizeof(slot_map)/sizeof(slot_map[0]);
```
